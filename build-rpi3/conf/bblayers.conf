## build-rpi3/conf/bblayers.conf
```bitbake
# POKY_BBLAYERS_CONF_VERSION is increased each time build/conf/bblayers.conf
# changes incompatibly
POKY_BBLAYERS_CONF_VERSION = "2"

BBPATH = "${TOPDIR}"
BBFILES ?= ""

REPO_ROOT := "${TOPDIR}/.."

BBLAYERS ?= " \
  ${REPO_ROOT}/poky/meta \
  ${REPO_ROOT}/poky/meta-poky \
  ${REPO_ROOT}/poky/meta-yocto-bsp \
  ${REPO_ROOT}/meta-openembedded/meta-oe \
  ${REPO_ROOT}/meta-openembedded/meta-python \
  ${REPO_ROOT}/meta-openembedded/meta-multimedia \
  ${REPO_ROOT}/meta-openembedded/meta-networking \
  ${REPO_ROOT}/meta-raspberrypi \
  ${REPO_ROOT}/meta-garage \
  "
```
