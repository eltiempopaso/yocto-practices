/dts-v1/;
/plugin/;

#include <dt-bindings/gpio/gpio.h>

/ {
    compatible = "brcm,bcm2837";

    push_button {
        compatible = "garage,my-push-button";

        button-gpios = <&gpio 27 GPIO_ACTIVE_LOW>;

        status = "okay";
    };
};
