## build-rpi2/conf/bblayers.conf
```bitbake
# POKY_BBLAYERS_CONF_VERSION is increased each time build/conf/bblayers.conf
# changes incompatibly
POKY_BBLAYERS_CONF_VERSION = "2"

BBPATH = "${TOPDIR}"
BBFILES ?= ""

BBLAYERS ?= " \
  /home/elotro/work/embedded/yocto/yocto-practices/poky/meta \
  /home/elotro/work/embedded/yocto/yocto-practices/poky/meta-poky \
  /home/elotro/work/embedded/yocto/yocto-practices/poky/meta-yocto-bsp \
  /home/elotro/work/embedded/yocto/yocto-practices/meta-raspberrypi \
  /home/elotro/work/embedded/yocto/yocto-practices/meta-garage \
  "
```

## build/conf/bblayers.conf
```bitbake
# POKY_BBLAYERS_CONF_VERSION is increased each time build/conf/bblayers.conf
# changes incompatibly
POKY_BBLAYERS_CONF_VERSION = "2"

BBPATH = "${TOPDIR}"
BBFILES ?= ""

BBLAYERS ?= " \
  /home/elotro/work/embedded/yocto/yocto-practices/poky/meta \
  /home/elotro/work/embedded/yocto/yocto-practices/poky/meta-poky \
  /home/elotro/work/embedded/yocto/yocto-practices/poky/meta-yocto-bsp \
  /home/elotro/work/embedded/yocto/yocto-practices/meta-arm/meta-arm-toolchain \
  /home/elotro/work/embedded/yocto/yocto-practices/meta-arm/meta-arm \
  /home/elotro/work/embedded/yocto/yocto-practices/meta-ti/meta-ti-bsp \
  "
```

## meta-garage/conf/layer.conf
```bitbake
# We have a conf and classes directory, add to BBPATH
BBPATH .= ":${LAYERDIR}"

# We have recipes-* directories, add to BBFILES
BBFILES += "${LAYERDIR}/recipes-*/*/*.bb \
            ${LAYERDIR}/recipes-*/*/*.bbappend"

BBFILE_COLLECTIONS += "meta-garage"
BBFILE_PATTERN_meta-garage = "^${LAYERDIR}/"
BBFILE_PRIORITY_meta-garage = "7"

LAYERDEPENDS_meta-garage = "core"
LAYERSERIES_COMPAT_meta-garage = "scarthgap"
```

## meta-uri/conf/layer.conf
```bitbake
# We have a conf and classes directory, add to BBPATH
BBPATH .= ":${LAYERDIR}"

# We have recipes-* directories, add to BBFILES
BBFILES += "${LAYERDIR}/recipes-*/*/*.bb \
            ${LAYERDIR}/recipes-*/*/*.bbappend"

BBFILE_COLLECTIONS += "meta-uri"
BBFILE_PATTERN_meta-uri = "^${LAYERDIR}/"
BBFILE_PRIORITY_meta-uri = "7"

LAYERDEPENDS_meta-uri = "core"
LAYERSERIES_COMPAT_meta-uri = "scarthgap"
```
